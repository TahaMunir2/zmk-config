// This file extends the two_percent_milk shield definition.

/ {
    chosen {
        zmk,kscan = &kscan0;
    };
};

// Add the PMW3360 sensor to your configuration
&spi1 {
    compatible = "nordic,nrf-spi";
    status = "okay";

    pmw3360: pmw3360@0 {
        compatible = "pixart,pmw3360";
        label = "PMW3360";
        spi-max-frequency = <1000000>;
        reg = <0>;

        // Change these pin numbers to match your wiring on the nice!nano v2
        cs-gpios = <&pro_micro 10 GPIO_ACTIVE_LOW>; // D4
        motion-gpios = <&pro_micro 12 GPIO_ACTIVE_HIGH>; // D5
    };
};
